#include <Arduino.h>
#include <WiFiS3.h>
#include <WiFiUdp.h>
#include <ArduinoMDNS.h>
#include <OneWire.h>
#include <DallasTemperature.h>
#include <ArduinoGraphics.h>
#include <Arduino_LED_Matrix.h>
#include <Adafruit_MAX31856.h>
#include "DebugLogger.h"
#include "EEPROM_Manager.h"
#include "PID_SSR.h"
#include "ProfileEngine.h"
#include "web_assets.h" // Generated by Python script
#include "SimpleWebSocket.h"

// --- Configuration ---
#define PIN_SENSOR 2
#define PIN_SSR 3
#define PIN_MAX_CS 10 // 8

// Helper to estimate free RAM on RA4M1
extern "C" char *sbrk(int i);
int getFreeRam() {
  char stack_dummy = 0;
  return &stack_dummy - sbrk(0);
}

// --- Globals ---
OneWire oneWire(PIN_SENSOR);
DallasTemperature sensors(&oneWire);
Adafruit_MAX31856 maxthermo(PIN_MAX_CS);
ArduinoLEDMatrix matrix;
WiFiServer webServer(80);
SimpleWS::WebSocketServer wsServer(81);
WiFiUDP udp;
MDNS mdns(udp);

EEPROMManager memory;
PID_SSR pid(PIN_SSR);
ProfileEngine profile;

// --- State Machine ---
enum SystemState { STATE_IDLE, STATE_RUNNING, STATE_PAUSED, STATE_TUNING, STATE_ERROR, STATE_MANUAL };
SystemState currentState = STATE_IDLE;
float manualPower = 0.0;
bool manualHeaterOn = false;

// --- Timers ---
unsigned long lastTelemetry = 0;
unsigned long lastTempRead = 0;
bool firstReading = true;
float currentTemp = 0.0;

// --- LED Matrix Frames (8x12) ---
const uint32_t icon_heat[] = { 0x3184a2, 0x94a529, 0x4a5294 }; // Flame-ish
const uint32_t icon_idle[] = { 0x000000, 0x000000, 0x0000ff }; // Dot
const uint32_t icon_err[]  = { 0x909000, 0x090900, 0x009090 }; // X

// Helper to scroll text on LED Matrix
void scrollText(String text) {
    matrix.beginDraw();
    matrix.stroke(0xFFFFFFFF);
    matrix.textScrollSpeed(50);
    matrix.textFont(Font_5x7);
    matrix.beginText(0, 1, 0xFFFFFF);
    matrix.println(text);
    matrix.endText(SCROLL_LEFT);
    matrix.endDraw();
}

void updateLEDMatrix() {
    switch(currentState) {
        case STATE_RUNNING: matrix.loadFrame(icon_heat); break;
        case STATE_ERROR:   matrix.loadFrame(icon_err); break;
        case STATE_MANUAL:  matrix.loadFrame(manualHeaterOn ? icon_heat : icon_idle); break;
        default:            matrix.loadFrame(icon_idle); break;
    }
}

void sendTelemetry() {
    static SystemState previousStateForTelemetry = currentState;
    static int reportCount = 0;
    reportCount++;

    // Send PID values if autotune just finished, or periodically
    bool autotuneJustFinished = (previousStateForTelemetry == STATE_TUNING && currentState == STATE_IDLE);
    bool sendPid = autotuneJustFinished || (reportCount % 10 == 0);

    // Broadcast JSON
    String json;
    json.reserve(256); // Prevent heap fragmentation
    json = "{";
    json += "\"temp\":" + String(currentTemp, 1) + ",";
    json += "\"set\":" + String(pid.setpoint, 1) + ",";
    json += "\"ssr\":" + String(pid.output, 0) + ",";
    json += "\"timer\":" + String(profile.getTimeRemaining()) + ",";
    json += "\"step\":" + String(profile.currentStepIndex + 1) + ",";
    
    String stateStr = "IDLE";
    if (currentState == STATE_RUNNING) stateStr = "RUNNING";
    else if (currentState == STATE_PAUSED) stateStr = "PAUSED";
    else if (currentState == STATE_TUNING) stateStr = "TUNING";
    else if (currentState == STATE_ERROR) stateStr = "ERROR";
    else if (currentState == STATE_MANUAL) stateStr = "MANUAL";
    json += "\"state\":\"" + stateStr + "\"";
    
    // Send PID values occasionally
    if (sendPid) {
        json += ",\"pid\":{";
        json += "\"kp\":" + String(pid.kp, 2) + ",";
        json += "\"ki\":" + String(pid.ki, 2) + ",";
        json += "\"kd\":" + String(pid.kd, 2) + ",";
        json += "\"ib\":" + String(pid.integralSeparationBand, 1) + ",";
        json += "\"df\":" + String(pid.dFilter, 2) + "}";
    }

    if (currentState == STATE_MANUAL) {
        json += ",\"man_on\":" + String(manualHeaterOn ? 1 : 0);
        json += ",\"man_pwr\":" + String(manualPower, 0);
    }

    json += "}";
    
    wsServer.broadcast(json);

    previousStateForTelemetry = currentState;
}

void setup() {
    LOG_INIT(115200);
    LOG_INFO("Booting R4 Thermal Controller...");

    matrix.begin();
    memory.begin();
    
    // Init PID
    pid.begin(memory.data.pid.kp, memory.data.pid.ki, memory.data.pid.kd);
    pid.integralSeparationBand = memory.data.pid.iBand;
    pid.dFilter = memory.data.pid.dFilter;

    // Init Sensors
    if (memory.data.sensorType == 1) {
        if (!maxthermo.begin()) {
            LOG_ERROR("MAX31856 not initialized!");
        }
        maxthermo.setThermocoupleType((max31856_thermocoupletype_t)memory.data.tcType);
        maxthermo.setConversionMode(MAX31856_CONTINUOUS);
    } else {
        sensors.begin();
        sensors.setWaitForConversion(false); // Non-blocking!
        sensors.requestTemperatures();
    }

    // WiFi
    if (WiFi.status() == WL_NO_MODULE) {
        LOG_ERROR("WiFi Module Failed!");
        while(true);
    }
    
    // 1. Start Access Point (Always available for config)
    LOG_INFO("Starting AP...");
    WiFi.beginAP("R4-Controller"); 
    LOG_VAR("AP IP", WiFi.localIP());

    // 2. Try to connect to local WiFi if configured
    if (strlen(memory.data.wifiSSID) > 0) {
        LOG_INFO("Connecting to WiFi...");
        LOG_VAR("SSID", memory.data.wifiSSID);
        
        WiFi.begin(memory.data.wifiSSID, memory.data.wifiPass);
        
        // Wait up to 10 seconds for connection, but don't block forever
        unsigned long startAttempt = millis();
        while (WiFi.status() != WL_CONNECTED && millis() - startAttempt < 10000) {
            delay(500);
            Serial.print(".");
        }
        
        if (WiFi.status() == WL_CONNECTED) {
            LOG_INFO("\nWiFi Connected.");
            unsigned long startWait = millis();
            while (WiFi.localIP() == IPAddress(0, 0, 0, 0)) {
            if (millis() - startWait > 15000) {
                Serial.println("Error: Timeout obtaining IP");
                break;
                }
                delay(100);
            }
            
            LOG_VAR("STA IP", WiFi.localIP());

            if (mdns.begin(WiFi.localIP(), memory.data.hostname)) {
                String svc = String(memory.data.hostname) + "._http";
                mdns.addServiceRecord(svc.c_str(), 80, MDNSServiceTCP);
                LOG_INFO("mDNS started");
            }
        } else {
            LOG_WARN("\nWiFi Connection Failed. Using AP only.");
            // Scroll AP IP on failure so user knows where to connect
            IPAddress ip = WiFi.localIP(); // In AP mode, localIP returns AP IP
            scrollText("AP: " + String(ip[0]) + "." + String(ip[1]) + "." + String(ip[2]) + "." + String(ip[3]));
        }
    } else {
        LOG_INFO("No WiFi configured. Using AP only.");
        // Scroll AP IP if unconfigured
        IPAddress ip = WiFi.localIP();
        scrollText("AP: " + String(ip[0]) + "." + String(ip[1]) + "." + String(ip[2]) + "." + String(ip[3]));
    }

    webServer.begin();
    wsServer.begin();
}

void loop() {
    unsigned long now = millis();
    mdns.run();

    // 1. WebSocket Handling
    wsServer.poll();

    // 2. Web Server (Serve Gzipped SPA)
    WiFiClient client = webServer.available();
    if (client) {
        String line = client.readStringUntil('\n');
        line.trim();
        
        // Basic Request Parsing
        String method = line.substring(0, line.indexOf(' '));
        String path = line.substring(line.indexOf(' ') + 1);
        path = path.substring(0, path.indexOf(' '));

        // Skip Headers
        while (client.available()) {
            String header = client.readStringUntil('\n');
            if (header == "\r") break;
        }

        if (method == "GET" && path == "/") {
            client.println("HTTP/1.1 200 OK");
            client.println("Content-Type: text/html");
            client.println("Connection: close");
            
            if (index_html_raw_len > 0) {
                client.println();
                client.write(index_html_raw, index_html_raw_len);
            } else {
                client.println("Content-Encoding: gzip");
                client.println();
                client.write(index_html_gz, index_html_gz_len);
            }
        }
        else if (method == "GET" && path == "/favicon.ico") {
            client.println("HTTP/1.1 200 OK");
            client.println("Content-Type: image/x-icon");
            client.println("Content-Encoding: gzip");
            client.println("Connection: close");
            client.println();
            client.write(favicon_gz, favicon_gz_len);
        }
        else if (method == "GET" && path.startsWith("/api/profile")) {
            int idIdx = path.indexOf("id=");
            int id = 0;
            if (idIdx > 0) id = path.substring(idIdx + 3).toInt();
            if (id < 0 || id >= MAX_PROFILES) id = 0;

            Profile* p = &memory.data.profiles[id];
            
            client.println("HTTP/1.1 200 OK");
            client.println("Content-Type: application/json");
            client.println("Connection: close");
            client.println();
            
            client.print("{\"id\":"); client.print(id);
            client.print(",\"name\":\""); client.print(p->name);
            client.print("\",\"steps\":[");
            for(int i=0; i<p->stepCount; i++) {
                if(i>0) client.print(",");
                client.print("{\"type\":"); client.print(p->steps[i].type);
                client.print(",\"target\":"); client.print(p->steps[i].targetTemp);
                client.print(",\"duration\":"); client.print(p->steps[i].durationSec);
                client.print("}");
            }
            client.println("]}");
        }
        else if (method == "GET" && path == "/api/info") {
            client.println("HTTP/1.1 200 OK");
            client.println("Content-Type: application/json");
            client.println("Connection: close");
            client.println();
            client.print("{\"uptime\":");
            client.print(millis());
            client.print(",\"ram\":");
            client.print(getFreeRam());
            client.print(",\"rssi\":");
            client.print(WiFi.RSSI());
            client.print(",\"sensor\":");
            client.print(memory.data.sensorType);
            client.print(",\"tcType\":");
            client.print(memory.data.tcType);
            client.print(",\"ssid\":\"");
            client.print(memory.data.wifiSSID);
            client.print("\",\"safety\":");
            client.print(memory.data.safetyLimit, 1);
            client.print(",\"hostname\":\"");
            client.print(memory.data.hostname);
            client.print("\"");
            client.println("}");
        }
        else if (method == "POST") {
            String body = client.readString();
            
            bool responseSent = false;
            if (path == "/api/command") {
                if (body.indexOf("start") > 0) {
                    if (currentState == STATE_PAUSED) {
                        profile.resume();
                        currentState = STATE_RUNNING;
                        LOG_INFO("API: Resume");
                    } else if (currentState == STATE_IDLE) {
                        profile.start(&memory.data.profiles[0], currentTemp);
                        currentState = STATE_RUNNING;
                        LOG_INFO("API: Start");
                    }
                } else if (body.indexOf("pause") > 0) {
                    if (currentState == STATE_RUNNING) {
                        profile.pause();
                        currentState = STATE_PAUSED;
                        LOG_INFO("API: Pause");
                    }
                } else if (body.indexOf("stop") > 0) {
                    profile.stop();
                    pid.cancelAutotune();
                    pid.output = 0;
                    currentState = STATE_IDLE;
                    LOG_INFO("API: Stop");
                } else if (body.indexOf("autotune") > 0) {
                    if (currentState == STATE_IDLE) {
                        currentState = STATE_TUNING;
                        pid.startAutotune(100.0);
                        LOG_INFO("API: Autotune");
                    }
                } else if (body.indexOf("manual_mode") > 0) {
                    int valIdx = body.indexOf("\"val\":");
                    if (valIdx > 0) {
                        int v = body.substring(valIdx + 6).toInt();
                        if (v == 1) {
                            currentState = STATE_MANUAL;
                            LOG_INFO("API: Manual Mode ON");
                        } else {
                            currentState = STATE_IDLE;
                            pid.output = 0;
                            LOG_INFO("API: Manual Mode OFF");
                        }
                    }
                } else if (body.indexOf("manual_pwr") > 0) {
                    int valIdx = body.indexOf("\"val\":");
                    if (valIdx > 0) {
                        manualPower = body.substring(valIdx + 6).toFloat();
                    }
                } else if (body.indexOf("manual_state") > 0) {
                    int valIdx = body.indexOf("\"val\":");
                    if (valIdx > 0) {
                        manualHeaterOn = (body.substring(valIdx + 6).toInt() == 1);
                        LOG_VAR("API: Manual Heater", manualHeaterOn);
                    }
                } else if (body.indexOf("reset") > 0) {
                    if (currentState == STATE_IDLE) {
                        memory.loadDefaults();
                        memory.save();
                        pid.begin(memory.data.pid.kp, memory.data.pid.ki, memory.data.pid.kd);
                        pid.integralSeparationBand = memory.data.pid.iBand;
                        pid.dFilter = memory.data.pid.dFilter;
                        LOG_INFO("API: Factory Reset");
                    }
                } else if (body.indexOf("reboot") > 0) {
                    LOG_INFO("API: Rebooting...");
                    client.println("HTTP/1.1 200 OK");
                    client.println("Connection: close");
                    client.println();
                    client.stop();
                    NVIC_SystemReset();
                }
            } else if (path == "/api/wifi") {
                int ssidIdx = body.indexOf("\"ssid\":");
                int passIdx = body.indexOf("\"pass\":");
                int hostIdx = body.indexOf("\"host\":");
                if (ssidIdx > 0) {
                    int start = body.indexOf("\"", ssidIdx + 7) + 1;
                    int end = body.indexOf("\"", start);
                    String s = body.substring(start, end);
                    
                    String p = "";
                    if (passIdx > 0) {
                        start = body.indexOf("\"", passIdx + 7) + 1;
                        end = body.indexOf("\"", start);
                        p = body.substring(start, end);
                    }

                    String h = "r4-controller";
                    if (hostIdx > 0) {
                        start = body.indexOf("\"", hostIdx + 7) + 1;
                        end = body.indexOf("\"", start);
                        h = body.substring(start, end);
                    }
                    
                    strncpy(memory.data.wifiSSID, s.c_str(), 31);
                    memory.data.wifiSSID[31] = 0;
                    strncpy(memory.data.wifiPass, p.c_str(), 63);
                    memory.data.wifiPass[63] = 0;
                    strncpy(memory.data.hostname, h.c_str(), 31);
                    memory.data.hostname[31] = 0;
                    memory.save();
                    LOG_INFO("API: WiFi Saved. Rebooting...");
                    
                    client.println("HTTP/1.1 200 OK");
                    client.println("Connection: close");
                    client.println();
                    client.println("{\"status\":\"rebooting\"}");
                    client.stop();
                    delay(100);
                    NVIC_SystemReset(); // Reboot to apply changes
                    responseSent = true;
                }
            } else if (path == "/api/forget") {
                memory.data.wifiSSID[0] = 0;
                memory.data.wifiPass[0] = 0;
                memory.save();
                LOG_INFO("API: Network Forgotten. Rebooting...");
                
                client.println("HTTP/1.1 200 OK");
                client.println("Connection: close");
                client.println();
                client.stop();
                delay(100);
                NVIC_SystemReset();
                responseSent = true;
            } else if (path == "/api/scan") {
                LOG_INFO("API: Scanning Networks...");
                int n = WiFi.scanNetworks();
                client.println("HTTP/1.1 200 OK");
                client.println("Content-Type: application/json");
                client.println("Connection: close");
                client.println();
                
                client.print("[");
                for (int i = 0; i < n; ++i) {
                    if (i > 0) client.print(",");
                    client.print("{\"ssid\":\"");
                    client.print(WiFi.SSID(i));
                    client.print("\",\"rssi\":");
                    client.print(WiFi.RSSI(i));
                    client.print("}");
                }
                client.println("]");
                LOG_INFO("Scan Complete");
                responseSent = true;
            } else if (path == "/api/safety") {
                int limitIdx = body.indexOf("\"limit\":");
                if (limitIdx > 0) {
                    float limit = body.substring(limitIdx + 8).toFloat();
                    if (limit > 0) {
                        memory.data.safetyLimit = limit;
                        memory.save();
                        LOG_INFO("API: Safety Limit Saved");
                    }
                }
            } else if (path == "/api/sensor") {
                int typeIdx = body.indexOf("\"type\":");
                int tcIdx = body.indexOf("\"tcType\":");
                if (typeIdx > 0) {
                    int type = body.substring(typeIdx + 7).toInt();
                    memory.data.sensorType = (type == 1) ? 1 : 0;
                    
                    if (tcIdx > 0) {
                        int tc = body.substring(tcIdx + 9).toInt();
                        if (tc >= 0 && tc <= 7) memory.data.tcType = tc;
                    }
                    memory.save();
                    LOG_INFO("API: Sensor Saved. Rebooting...");
                    client.println("HTTP/1.1 200 OK\r\nConnection: close\r\n\r\n{\"status\":\"rebooting\"}");
                    client.stop();
                    delay(100);
                    NVIC_SystemReset();
                    responseSent = true;
                }
            } else if (path == "/api/pid") {
                int kpIdx = body.indexOf("\"kp\":");
                int kiIdx = body.indexOf("\"ki\":");
                int kdIdx = body.indexOf("\"kd\":");
                int ibIdx = body.indexOf("\"ib\":");
                int dfIdx = body.indexOf("\"df\":");
                if (kpIdx > 0 && kiIdx > 0 && kdIdx > 0) {
                    memory.data.pid.kp = body.substring(kpIdx+5).toFloat();
                    memory.data.pid.ki = body.substring(kiIdx+5).toFloat();
                    memory.data.pid.kd = body.substring(kdIdx+5).toFloat();
                    if (ibIdx > 0) memory.data.pid.iBand = body.substring(ibIdx+5).toFloat();
                    if (dfIdx > 0) memory.data.pid.dFilter = body.substring(dfIdx+5).toFloat();
                    memory.save();
                    pid.kp = memory.data.pid.kp;
                    pid.ki = memory.data.pid.ki;
                    pid.kd = memory.data.pid.kd;
                    pid.integralSeparationBand = memory.data.pid.iBand;
                    pid.dFilter = memory.data.pid.dFilter;
                    LOG_INFO("API: PID Saved");
                }
            }
            else if (path == "/api/profile") {
                // Manual JSON Parsing for Profile
                int idIdx = body.indexOf("\"id\":");
                if (idIdx > 0) {
                    int id = body.substring(idIdx + 5).toInt();
                    if (id >= 0 && id < MAX_PROFILES) {
                        Profile* p = &memory.data.profiles[id];
                        
                        // Name
                        int nameIdx = body.indexOf("\"name\":");
                        if (nameIdx > 0) {
                            int start = body.indexOf("\"", nameIdx + 7) + 1;
                            int end = body.indexOf("\"", start);
                            String name = body.substring(start, end);
                            strncpy(p->name, name.c_str(), 15);
                            p->name[15] = 0;
                        }

                        // Steps
                        p->stepCount = 0;
                        int stepSearchPos = body.indexOf("\"steps\":");
                        while (stepSearchPos > 0 && p->stepCount < MAX_STEPS) {
                            int typeIdx = body.indexOf("\"type\":", stepSearchPos);
                            if (typeIdx == -1) break;
                            
                            int targetIdx = body.indexOf("\"target\":", typeIdx);
                            int durIdx = body.indexOf("\"duration\":", targetIdx);
                            if (targetIdx == -1 || durIdx == -1) break;

                            p->steps[p->stepCount].type = (StepType)body.substring(typeIdx + 7).toInt();
                            p->steps[p->stepCount].targetTemp = body.substring(targetIdx + 9).toFloat();
                            p->steps[p->stepCount].durationSec = body.substring(durIdx + 11).toInt();
                            p->stepCount++;
                            stepSearchPos = durIdx + 10;
                        }
                        memory.save();
                        LOG_INFO("API: Profile Saved");
                    }
                }
            }
            if (!responseSent) {
                client.println("HTTP/1.1 200 OK");
                client.println("Connection: close");
                client.println();
                client.println("{\"status\":\"ok\"}");
            }
        }
        client.stop();
    }

    // 3. Sensor Reading (Non-blocking)
    if (now - lastTempRead > 750) { // DS18B20 conversion time
        float t = 0;
        if (memory.data.sensorType == 1) {
            t = maxthermo.readThermocoupleTemperature();
            if (isnan(t)) t = -127.0; // Treat as error
        } else {
            t = sensors.getTempCByIndex(0);
            sensors.requestTemperatures(); // Start next conversion
        }

        if (t == -127.0 || t > 1300.0) { // Expanded range for thermocouple
            currentState = STATE_ERROR;
            pid.output = 0;
            LOG_ERROR("Sensor Fault or Overheat!");
        } else {
            if (firstReading) {
                currentTemp = t;
                firstReading = false;
            } else {
                currentTemp = (0.3 * t) + (0.7 * currentTemp); // EMA Smoothing (Alpha 0.3)
            }
            
            if (currentTemp > memory.data.safetyLimit) {
                currentState = STATE_ERROR;
                pid.output = 0;
                LOG_ERROR("Safety Cutoff Triggered!");
            }
        }
        lastTempRead = now;
    }

    // 4. Logic Engine
    if (currentState == STATE_RUNNING) {
        pid.setpoint = profile.update(currentTemp);
        if (!profile.isRunning) currentState = STATE_IDLE;
    }
    
    // 5. PID & Output
    if (currentState == STATE_RUNNING || currentState == STATE_TUNING) {
        pid.update(currentTemp);
        
        // Autotune completion check
        if (currentState == STATE_TUNING && !pid.isTuning) {
            currentState = STATE_IDLE;
            memory.data.pid = {pid.kp, pid.ki, pid.kd, pid.integralSeparationBand, pid.dFilter};
            memory.save();
        }
    } else if (currentState == STATE_MANUAL) {
        // Manual Control
        pid.manualUpdate(manualHeaterOn ? manualPower : 0.0);
        pid.setpoint = 0; 
    } else {
        pid.output = 0;
        digitalWrite(PIN_SSR, LOW); // Hard safety
    }

    // 6. Telemetry & UI
    if (now - lastTelemetry > 500) { // 2Hz UI update
        sendTelemetry();
        updateLEDMatrix();
        lastTelemetry = now;
    }
    
    // Watchdog reset would go here if using WDT
}
