#include <Arduino.h>
#include <WiFiS3.h>
#include <WiFiUdp.h>
#include <ArduinoMDNS.h>
#include <OneWire.h>
#include <DallasTemperature.h>
#include <Adafruit_MAX31856.h>
#include "DebugLogger.h"
#include "EEPROM_Manager.h"
#include "PID_SSR.h"
#include "ProfileEngine.h"
#include "web_assets.h" // Generated by Python script
#include "SimpleWebSocket.h"

// --- Configuration ---
#define PIN_SENSOR 2
#define PIN_SSR 3
#define PIN_MAX_CS 10 // 8

// Helper to estimate free RAM on RA4M1
extern "C" char *sbrk(int i);
int getFreeRam() {
  char stack_dummy = 0;
  return &stack_dummy - sbrk(0);
}

// --- Globals ---
OneWire oneWire(PIN_SENSOR);
DallasTemperature sensors(&oneWire);
Adafruit_MAX31856 maxthermo(PIN_MAX_CS);
WiFiServer webServer(80);
SimpleWS::WebSocketServer wsServer(81);
WiFiUDP udp;
MDNS mdns(udp);

EEPROMManager memory;
PID_SSR pid(PIN_SSR);
ProfileEngine profile;

// --- State Machine ---
enum SystemState { STATE_IDLE, STATE_RUNNING, STATE_PAUSED, STATE_TUNING, STATE_ERROR, STATE_MANUAL };
SystemState currentState = STATE_IDLE;
float manualPower = 0.0;
bool manualHeaterOn = false;

// --- Timers & WiFi Status ---
unsigned long lastTelemetry = 0;
unsigned long lastTempRead = 0;
bool firstReading = true;
float currentTemp = 0.0;
bool isApMode = false;
unsigned long lastWifiCheck = 0;
unsigned long lastMdnsRun = 0;


void sendTelemetry() {
    static SystemState previousStateForTelemetry = currentState;
    static int reportCount = 0;
    reportCount++;

    // Send PID values if autotune just finished, or periodically
    bool autotuneJustFinished = (previousStateForTelemetry == STATE_TUNING && currentState == STATE_IDLE);
    bool sendPid = autotuneJustFinished || (reportCount % 10 == 0);

    const char* stateStr = "IDLE";
    if (currentState == STATE_RUNNING) stateStr = "RUNNING";
    else if (currentState == STATE_PAUSED) stateStr = "PAUSED";
    else if (currentState == STATE_TUNING) stateStr = "TUNING";
    else if (currentState == STATE_ERROR) stateStr = "ERROR";
    else if (currentState == STATE_MANUAL) stateStr = "MANUAL";

    // Zero-heap stack buffer for JSON telemetry
    char jsonBuf[384];
    int len = snprintf(jsonBuf, sizeof(jsonBuf),
        "{\"temp\":%.1f,\"set\":%.1f,\"ssr\":%.0f,\"timer\":%lu,\"step\":%d,\"state\":\"%s\"",
        currentTemp,
        pid.setpoint,
        pid.output,
        profile.getTimeRemaining(),
        profile.currentStepIndex + 1,
        stateStr
    );

    if (sendPid && len > 0 && len < (int)sizeof(jsonBuf) - 100) {
        len += snprintf(jsonBuf + len, sizeof(jsonBuf) - len,
            ",\"pid\":{\"kp\":%.2f,\"ki\":%.2f,\"kd\":%.2f,\"ib\":%.1f,\"df\":%.2f}",
            pid.kp, pid.ki, pid.kd, pid.integralSeparationBand, pid.dFilter
        );
    }

    if (currentState == STATE_MANUAL && len > 0 && len < (int)sizeof(jsonBuf) - 50) {
        len += snprintf(jsonBuf + len, sizeof(jsonBuf) - len,
            ",\"man_on\":%d,\"man_pwr\":%.0f",
            manualHeaterOn ? 1 : 0,
            manualPower
        );
    }

    if (len > 0 && len < (int)sizeof(jsonBuf) - 2) {
        jsonBuf[len++] = '}';
        jsonBuf[len] = '\0';
    }

    wsServer.broadcast(jsonBuf);

    previousStateForTelemetry = currentState;
}

void setup() {
    LOG_INIT(115200);
    LOG_INFO("Booting R4 Thermal Controller...");

    memory.begin();
    
    // Init PID
    pid.begin(memory.data.pid.kp, memory.data.pid.ki, memory.data.pid.kd);
    pid.integralSeparationBand = memory.data.pid.iBand;
    pid.dFilter = memory.data.pid.dFilter;

    // Init Sensors
    if (memory.data.sensorType == 1) {
        if (!maxthermo.begin()) {
            LOG_ERROR("MAX31856 not initialized!");
        }
        maxthermo.setThermocoupleType((max31856_thermocoupletype_t)memory.data.tcType);
        maxthermo.setConversionMode(MAX31856_CONTINUOUS);
    } else {
        sensors.begin();
        sensors.setWaitForConversion(false); // Non-blocking!
        sensors.requestTemperatures();
    }

    // WiFi
    if (WiFi.status() == WL_NO_MODULE) {
        LOG_ERROR("WiFi Module Failed!");
        while(true);
    }
    
    bool staConnected = false;

    // 1. Try to connect to local WiFi first if configured (avoid simultaneous AP+STA radio conflicts)
    if (strlen(memory.data.wifiSSID) > 0) {
        LOG_INFO("Connecting to WiFi...");
        LOG_VAR("SSID", memory.data.wifiSSID);
        
        WiFi.begin(memory.data.wifiSSID, memory.data.wifiPass);
        
        // Wait up to 10 seconds for connection
        unsigned long startAttempt = millis();
        while (WiFi.status() != WL_CONNECTED && millis() - startAttempt < 10000) {
            delay(500);
            Serial.print(".");
        }
        
        if (WiFi.status() == WL_CONNECTED) {
            // Wait for valid IP from DHCP
            unsigned long startWait = millis();
            while (WiFi.localIP() == IPAddress(0, 0, 0, 0)) {
                if (millis() - startWait > 10000) {
                    Serial.println("\nError: Timeout obtaining IP");
                    break;
                }
                delay(100);
            }
            
            if (WiFi.localIP() != IPAddress(0, 0, 0, 0)) {
                staConnected = true;
                isApMode = false;
                LOG_INFO("\nWiFi Connected.");
                LOG_VAR("STA IP", WiFi.localIP());

                if (mdns.begin(WiFi.localIP(), memory.data.hostname)) {
                    String svc = String(memory.data.hostname) + "._http";
                    mdns.addServiceRecord(svc.c_str(), 80, MDNSServiceTCP);
                    LOG_INFO("mDNS started");
                }
            }
        }
        
        if (!staConnected) {
            LOG_WARN("\nWiFi Connection Failed. Falling back to AP mode.");
        }
    } else {
        LOG_INFO("No WiFi configured. Starting AP mode.");
    }

    // 2. Start Access Point only if Station connection is not active
    if (!staConnected) {
        isApMode = true;
        LOG_INFO("Starting AP...");
        WiFi.beginAP("R4-Controller"); 
        LOG_VAR("AP IP", WiFi.localIP());
    }

    webServer.begin();
    wsServer.begin();
}

void loop() {
    unsigned long now = millis();

    // Throttled mDNS servicing (10Hz) to prevent bus saturation
    if (!isApMode && now - lastMdnsRun >= 100) {
        lastMdnsRun = now;
        mdns.run();
    }

    // Non-blocking WiFi reconnect watchdog (Station mode only, check every 10s)
    if (!isApMode && strlen(memory.data.wifiSSID) > 0) {
        if (now - lastWifiCheck >= 10000) {
            lastWifiCheck = now;
            if (WiFi.status() != WL_CONNECTED) {
                LOG_WARN("WiFi lost. Reconnecting...");
                WiFi.begin(memory.data.wifiSSID, memory.data.wifiPass);
            }
        }
    }

    // 1. WebSocket Handling
    wsServer.poll();

    // 2. Web Server (Serve Gzipped SPA)
    WiFiClient client = webServer.available();
    if (client) {
        client.setTimeout(150); // Fast timeout to avoid stalling on speculative pre-connections
        String line = client.readStringUntil('\n');
        line.trim();
        
        if (line.length() > 0) {
            // Basic Request Parsing
            int firstSpace = line.indexOf(' ');
            int secondSpace = line.indexOf(' ', firstSpace + 1);
            String method = (firstSpace > 0) ? line.substring(0, firstSpace) : "";
            String path = (firstSpace > 0 && secondSpace > firstSpace) ? line.substring(firstSpace + 1, secondSpace) : "/";

            // Skip and parse Headers
            int contentLength = 0;
            while (client.connected()) {
                String header = client.readStringUntil('\n');
                header.trim();
                if (header.length() == 0) break; // Empty line ends HTTP headers
                if (header.startsWith("Content-Length:") || header.startsWith("content-length:")) {
                    contentLength = header.substring(15).toInt();
                }
            }

        if (method == "GET" && path == "/") {
            client.println("HTTP/1.1 200 OK");
            client.println("Content-Type: text/html");
            client.println("Connection: close");
            
            if (index_html_raw_len > 0) {
                client.println();
                client.write(index_html_raw, index_html_raw_len);
            } else {
                client.println("Content-Encoding: gzip");
                client.println();
                client.write(index_html_gz, index_html_gz_len);
            }
        }
        else if (method == "GET" && path == "/favicon.ico") {
            client.println("HTTP/1.1 200 OK");
            client.println("Content-Type: image/x-icon");
            client.println("Content-Encoding: gzip");
            client.println("Connection: close");
            client.println();
            client.write(favicon_gz, favicon_gz_len);
        }
        else if (method == "GET" && path.startsWith("/api/profile")) {
            int idIdx = path.indexOf("id=");
            int id = 0;
            if (idIdx > 0) id = path.substring(idIdx + 3).toInt();
            if (id < 0 || id >= MAX_PROFILES) id = 0;

            Profile* p = &memory.data.profiles[id];
            
            client.println("HTTP/1.1 200 OK");
            client.println("Content-Type: application/json");
            client.println("Connection: close");
            client.println();
            
            client.print("{\"id\":"); client.print(id);
            client.print(",\"name\":\""); client.print(p->name);
            client.print("\",\"steps\":[");
            for(int i=0; i<p->stepCount; i++) {
                if(i>0) client.print(",");
                client.print("{\"type\":"); client.print(p->steps[i].type);
                client.print(",\"target\":"); client.print(p->steps[i].targetTemp);
                client.print(",\"duration\":"); client.print(p->steps[i].durationSec);
                client.print("}");
            }
            client.println("]}");
        }
        else if (method == "GET" && path == "/api/info") {
            client.println("HTTP/1.1 200 OK");
            client.println("Content-Type: application/json");
            client.println("Connection: close");
            client.println();
            client.print("{\"uptime\":");
            client.print(millis());
            client.print(",\"ram\":");
            client.print(getFreeRam());
            client.print(",\"rssi\":");
            client.print(WiFi.RSSI());
            client.print(",\"sensor\":");
            client.print(memory.data.sensorType);
            client.print(",\"tcType\":");
            client.print(memory.data.tcType);
            client.print(",\"ssid\":\"");
            client.print(memory.data.wifiSSID);
            client.print("\",\"safety\":");
            client.print(memory.data.safetyLimit, 1);
            client.print(",\"hostname\":\"");
            client.print(memory.data.hostname);
            client.print("\"");
            client.println("}");
        }
        else if (method == "POST") {
            String body = "";
            if (contentLength > 0 && contentLength < 4096) {
                body.reserve(contentLength + 1);
                unsigned long readStart = millis();
                while (body.length() < (size_t)contentLength && millis() - readStart < 600) {
                    if (client.available()) {
                        body += (char)client.read();
                    } else {
                        delay(2);
                    }
                }
            } else {
                unsigned long readStart = millis();
                while (client.available() && millis() - readStart < 400) {
                    body += (char)client.read();
                }
            }
            
            bool responseSent = false;
            if (path == "/api/command") {
                if (body.indexOf("start") > 0) {
                    if (currentState == STATE_PAUSED) {
                        profile.resume();
                        currentState = STATE_RUNNING;
                        LOG_INFO("API: Resume");
                    } else if (currentState == STATE_IDLE) {
                        profile.start(&memory.data.profiles[0], currentTemp);
                        currentState = STATE_RUNNING;
                        LOG_INFO("API: Start");
                    }
                } else if (body.indexOf("pause") > 0) {
                    if (currentState == STATE_RUNNING) {
                        profile.pause();
                        currentState = STATE_PAUSED;
                        LOG_INFO("API: Pause");
                    }
                } else if (body.indexOf("stop") > 0) {
                    profile.stop();
                    pid.cancelAutotune();
                    pid.output = 0;
                    currentState = STATE_IDLE;
                    LOG_INFO("API: Stop");
                } else if (body.indexOf("autotune") > 0) {
                    if (currentState == STATE_IDLE) {
                        currentState = STATE_TUNING;
                        pid.startAutotune(100.0);
                        LOG_INFO("API: Autotune");
                    }
                } else if (body.indexOf("manual_mode") > 0) {
                    int valIdx = body.indexOf("\"val\":");
                    if (valIdx > 0) {
                        int v = body.substring(valIdx + 6).toInt();
                        if (v == 1) {
                            currentState = STATE_MANUAL;
                            LOG_INFO("API: Manual Mode ON");
                        } else {
                            currentState = STATE_IDLE;
                            pid.output = 0;
                            LOG_INFO("API: Manual Mode OFF");
                        }
                    }
                } else if (body.indexOf("manual_pwr") > 0) {
                    int valIdx = body.indexOf("\"val\":");
                    if (valIdx > 0) {
                        manualPower = body.substring(valIdx + 6).toFloat();
                    }
                } else if (body.indexOf("manual_state") > 0) {
                    int valIdx = body.indexOf("\"val\":");
                    if (valIdx > 0) {
                        manualHeaterOn = (body.substring(valIdx + 6).toInt() == 1);
                        LOG_VAR("API: Manual Heater", manualHeaterOn);
                    }
                } else if (body.indexOf("reset") > 0) {
                    if (currentState == STATE_IDLE) {
                        memory.loadDefaults();
                        memory.save();
                        pid.begin(memory.data.pid.kp, memory.data.pid.ki, memory.data.pid.kd);
                        pid.integralSeparationBand = memory.data.pid.iBand;
                        pid.dFilter = memory.data.pid.dFilter;
                        LOG_INFO("API: Factory Reset");
                    }
                } else if (body.indexOf("reboot") > 0) {
                    LOG_INFO("API: Rebooting...");
                    client.println("HTTP/1.1 200 OK");
                    client.println("Connection: close");
                    client.println();
                    client.stop();
                    NVIC_SystemReset();
                }
            } else if (path == "/api/wifi") {
                int ssidIdx = body.indexOf("\"ssid\":");
                int passIdx = body.indexOf("\"pass\":");
                int hostIdx = body.indexOf("\"host\":");
                if (ssidIdx > 0) {
                    int start = body.indexOf("\"", ssidIdx + 7) + 1;
                    int end = body.indexOf("\"", start);
                    String s = body.substring(start, end);
                    
                    String p = "";
                    if (passIdx > 0) {
                        start = body.indexOf("\"", passIdx + 7) + 1;
                        end = body.indexOf("\"", start);
                        p = body.substring(start, end);
                    }

                    String h = "r4-controller";
                    if (hostIdx > 0) {
                        start = body.indexOf("\"", hostIdx + 7) + 1;
                        end = body.indexOf("\"", start);
                        h = body.substring(start, end);
                    }
                    
                    strncpy(memory.data.wifiSSID, s.c_str(), 31);
                    memory.data.wifiSSID[31] = 0;
                    strncpy(memory.data.wifiPass, p.c_str(), 63);
                    memory.data.wifiPass[63] = 0;
                    strncpy(memory.data.hostname, h.c_str(), 31);
                    memory.data.hostname[31] = 0;
                    memory.save();
                    LOG_INFO("API: WiFi Saved. Rebooting...");
                    
                    client.println("HTTP/1.1 200 OK");
                    client.println("Connection: close");
                    client.println();
                    client.println("{\"status\":\"rebooting\"}");
                    client.stop();
                    delay(100);
                    NVIC_SystemReset(); // Reboot to apply changes
                    responseSent = true;
                }
            } else if (path == "/api/forget") {
                memory.data.wifiSSID[0] = 0;
                memory.data.wifiPass[0] = 0;
                memory.save();
                LOG_INFO("API: Network Forgotten. Rebooting...");
                
                client.println("HTTP/1.1 200 OK");
                client.println("Connection: close");
                client.println();
                client.stop();
                delay(100);
                NVIC_SystemReset();
                responseSent = true;
            } else if (path == "/api/scan") {
                LOG_INFO("API: Scanning Networks...");
                int n = WiFi.scanNetworks();
                client.println("HTTP/1.1 200 OK");
                client.println("Content-Type: application/json");
                client.println("Connection: close");
                client.println();
                
                client.print("[");
                for (int i = 0; i < n; ++i) {
                    if (i > 0) client.print(",");
                    client.print("{\"ssid\":\"");
                    client.print(WiFi.SSID(i));
                    client.print("\",\"rssi\":");
                    client.print(WiFi.RSSI(i));
                    client.print("}");
                }
                client.println("]");
                LOG_INFO("Scan Complete");
                responseSent = true;
            } else if (path == "/api/safety") {
                int limitIdx = body.indexOf("\"limit\":");
                if (limitIdx > 0) {
                    float limit = body.substring(limitIdx + 8).toFloat();
                    if (limit > 0) {
                        memory.data.safetyLimit = limit;
                        memory.save();
                        LOG_INFO("API: Safety Limit Saved");
                    }
                }
            } else if (path == "/api/sensor") {
                int typeIdx = body.indexOf("\"type\":");
                int tcIdx = body.indexOf("\"tcType\":");
                if (typeIdx > 0) {
                    int type = body.substring(typeIdx + 7).toInt();
                    memory.data.sensorType = (type == 1) ? 1 : 0;
                    
                    if (tcIdx > 0) {
                        int tc = body.substring(tcIdx + 9).toInt();
                        if (tc >= 0 && tc <= 7) memory.data.tcType = tc;
                    }
                    memory.save();
                    LOG_INFO("API: Sensor Saved. Rebooting...");
                    client.println("HTTP/1.1 200 OK\r\nConnection: close\r\n\r\n{\"status\":\"rebooting\"}");
                    client.stop();
                    delay(100);
                    NVIC_SystemReset();
                    responseSent = true;
                }
            } else if (path == "/api/pid") {
                int kpIdx = body.indexOf("\"kp\":");
                int kiIdx = body.indexOf("\"ki\":");
                int kdIdx = body.indexOf("\"kd\":");
                int ibIdx = body.indexOf("\"ib\":");
                int dfIdx = body.indexOf("\"df\":");
                if (kpIdx > 0 && kiIdx > 0 && kdIdx > 0) {
                    memory.data.pid.kp = body.substring(kpIdx+5).toFloat();
                    memory.data.pid.ki = body.substring(kiIdx+5).toFloat();
                    memory.data.pid.kd = body.substring(kdIdx+5).toFloat();
                    if (ibIdx > 0) memory.data.pid.iBand = body.substring(ibIdx+5).toFloat();
                    if (dfIdx > 0) memory.data.pid.dFilter = body.substring(dfIdx+5).toFloat();
                    memory.save();
                    pid.kp = memory.data.pid.kp;
                    pid.ki = memory.data.pid.ki;
                    pid.kd = memory.data.pid.kd;
                    pid.integralSeparationBand = memory.data.pid.iBand;
                    pid.dFilter = memory.data.pid.dFilter;
                    LOG_INFO("API: PID Saved");
                }
            }
            else if (path == "/api/profile") {
                // Manual JSON Parsing for Profile
                int idIdx = body.indexOf("\"id\":");
                if (idIdx > 0) {
                    int id = body.substring(idIdx + 5).toInt();
                    if (id >= 0 && id < MAX_PROFILES) {
                        Profile* p = &memory.data.profiles[id];
                        
                        // Name
                        int nameIdx = body.indexOf("\"name\":");
                        if (nameIdx > 0) {
                            int start = body.indexOf("\"", nameIdx + 7) + 1;
                            int end = body.indexOf("\"", start);
                            String name = body.substring(start, end);
                            strncpy(p->name, name.c_str(), 15);
                            p->name[15] = 0;
                        }

                        // Steps
                        p->stepCount = 0;
                        int stepSearchPos = body.indexOf("\"steps\":");
                        while (stepSearchPos > 0 && p->stepCount < MAX_STEPS) {
                            int typeIdx = body.indexOf("\"type\":", stepSearchPos);
                            if (typeIdx == -1) break;
                            
                            int targetIdx = body.indexOf("\"target\":", typeIdx);
                            int durIdx = body.indexOf("\"duration\":", targetIdx);
                            if (targetIdx == -1 || durIdx == -1) break;

                            p->steps[p->stepCount].type = (StepType)body.substring(typeIdx + 7).toInt();
                            p->steps[p->stepCount].targetTemp = body.substring(targetIdx + 9).toFloat();
                            p->steps[p->stepCount].durationSec = body.substring(durIdx + 11).toInt();
                            p->stepCount++;
                            stepSearchPos = durIdx + 10;
                        }
                        memory.save();
                        LOG_INFO("API: Profile Saved");
                    }
                }
            }
            if (!responseSent) {
                client.println("HTTP/1.1 200 OK");
                client.println("Connection: close");
                client.println();
                client.println("{\"status\":\"ok\"}");
            }
        } else {
            client.println("HTTP/1.1 404 Not Found");
            client.println("Connection: close");
            client.println("Content-Type: text/plain");
            client.println();
            client.println("Not Found");
        }
    }
    client.stop();
}

    // 3. Sensor Reading (Non-blocking)
    if (now - lastTempRead > 750) { // DS18B20 conversion time
        float t = 0;
        if (memory.data.sensorType == 1) {
            t = maxthermo.readThermocoupleTemperature();
            if (isnan(t)) t = -127.0; // Treat as error
        } else {
            t = sensors.getTempCByIndex(0);
            sensors.requestTemperatures(); // Start next conversion
        }

        if (t == -127.0 || t > 1300.0) { // Expanded range for thermocouple
            currentState = STATE_ERROR;
            pid.output = 0;
            LOG_ERROR("Sensor Fault or Overheat!");
        } else {
            if (firstReading) {
                currentTemp = t;
                firstReading = false;
            } else {
                currentTemp = (0.3 * t) + (0.7 * currentTemp); // EMA Smoothing (Alpha 0.3)
            }
            
            if (currentTemp > memory.data.safetyLimit) {
                currentState = STATE_ERROR;
                pid.output = 0;
                LOG_ERROR("Safety Cutoff Triggered!");
            }
        }
        lastTempRead = now;
    }

    // 4. Logic Engine
    if (currentState == STATE_RUNNING) {
        pid.setpoint = profile.update(currentTemp);
        if (!profile.isRunning) currentState = STATE_IDLE;
    }
    
    // 5. PID & Output
    if (currentState == STATE_RUNNING || currentState == STATE_TUNING) {
        pid.update(currentTemp);
        
        // Autotune completion check
        if (currentState == STATE_TUNING && !pid.isTuning) {
            currentState = STATE_IDLE;
            memory.data.pid = {pid.kp, pid.ki, pid.kd, pid.integralSeparationBand, pid.dFilter};
            memory.save();
        }
    } else if (currentState == STATE_MANUAL) {
        // Manual Control
        pid.manualUpdate(manualHeaterOn ? manualPower : 0.0);
        pid.setpoint = 0; 
    } else {
        pid.output = 0;
        digitalWrite(PIN_SSR, LOW); // Hard safety
    }

    // 6. Telemetry & UI
    if (now - lastTelemetry > 500) { // 2Hz UI update
        sendTelemetry();
        lastTelemetry = now;
    }
    
    // Watchdog reset would go here if using WDT
}
